/*
  PIC18F47Q43 ROM RAM and UART emulation firmware
  This single source file contains all code

  Target: EMUZ80 - The computer with only Z80 and PIC18F47Q43
  Compiler: MPLAB XC8 v2.36
  Written by Tetsuya Suzuki

  Target: EMU1802mini - The computer with only COSMAC CDP1802 and PIC18F27Q43
  Modifed by Kazuhiro Ouchi
  V1.0 2022-06-19
  V1.1 2022-07-03
*/

//
// EMU1802-mini
//
// PORTB: ADDRESS BUS
// PORTC: DATA BUS
// RA7 RXD
// RA6 TXD
// RA5 ~MRD
// RA4 CLOCK
// RA3 TPA
// RA2 TPB
// RA1 ~CLEAR
// RA0 ~MWR

// CONFIG1
#pragma config FEXTOSC = OFF    // External Oscillator Selection (Oscillator not enabled)
#pragma config RSTOSC = HFINTOSC_64MHZ// Reset Oscillator Selection (HFINTOSC with HFFRQ = 64 MHz and CDIV = 1:1)

// CONFIG2
#pragma config CLKOUTEN = OFF   // Clock out Enable bit (CLKOUT function is disabled)
#pragma config PR1WAY = ON      // PRLOCKED One-Way Set Enable bit (PRLOCKED bit can be cleared and set only once)
#pragma config CSWEN = ON       // Clock Switch Enable bit (Writing to NOSC and NDIV is allowed)
#pragma config FCMEN = ON       // Fail-Safe Clock Monitor Enable bit (Fail-Safe Clock Monitor enabled)

// CONFIG3
#pragma config MCLRE = EXTMCLR  // MCLR Enable bit (If LVP = 0, MCLR pin is MCLR; If LVP = 1, RE3 pin function is MCLR )
#pragma config PWRTS = PWRT_OFF // Power-up timer selection bits (PWRT is disabled)
#pragma config MVECEN = ON      // Multi-vector enable bit (Multi-vector enabled, Vector table used for interrupts)
#pragma config IVT1WAY = ON     // IVTLOCK bit One-way set enable bit (IVTLOCKED bit can be cleared and set only once)
#pragma config LPBOREN = OFF    // Low Power BOR Enable bit (Low-Power BOR disabled)
#pragma config BOREN = SBORDIS  // Brown-out Reset Enable bits (Brown-out Reset enabled , SBOREN bit is ignored)

// CONFIG4
#pragma config BORV = VBOR_1P9  // Brown-out Reset Voltage Selection bits (Brown-out Reset Voltage (VBOR) set to 1.9V)
#pragma config ZCD = OFF        // ZCD Disable bit (ZCD module is disabled. ZCD can be enabled by setting the ZCDSEN bit of ZCDCON)
#pragma config PPS1WAY = OFF    // PPSLOCK bit One-Way Set Enable bit (PPSLOCKED bit can be set and cleared repeatedly (subject to the unlock sequence))
#pragma config STVREN = ON      // Stack Full/Underflow Reset Enable bit (Stack full/underflow will cause Reset)
#pragma config LVP = ON         // Low Voltage Programming Enable bit (Low voltage programming enabled. MCLR/VPP pin function is MCLR. MCLRE configuration bit is ignored)
#pragma config XINST = OFF      // Extended Instruction Set Enable bit (Extended Instruction Set and Indexed Addressing Mode disabled)

// CONFIG5
#pragma config WDTCPS = WDTCPS_31// WDT Period selection bits (Divider ratio 1:65536; software control of WDTPS)
#pragma config WDTE = OFF       // WDT operating mode (WDT Disabled; SWDTEN is ignored)

// CONFIG6
#pragma config WDTCWS = WDTCWS_7// WDT Window Select bits (window always open (100%); software control; keyed access not required)
#pragma config WDTCCS = SC      // WDT input clock selector (Software Control)

// CONFIG7
#pragma config BBSIZE = BBSIZE_512// Boot Block Size selection bits (Boot Block size is 512 words)
#pragma config BBEN = OFF       // Boot Block enable bit (Boot block disabled)
#pragma config SAFEN = OFF      // Storage Area Flash enable bit (SAF disabled)
#pragma config DEBUG = OFF      // Background Debugger (Background Debugger disabled)

// CONFIG8
#pragma config WRTB = OFF       // Boot Block Write Protection bit (Boot Block not Write protected)
#pragma config WRTC = OFF       // Configuration Register Write Protection bit (Configuration registers not Write protected)
#pragma config WRTD = OFF       // Data EEPROM Write Protection bit (Data EEPROM not Write protected)
#pragma config WRTSAF = OFF     // SAF Write protection bit (SAF not Write Protected)
#pragma config WRTAPP = OFF     // Application Block write protection bit (Application Block not write protected)

// CONFIG10
#pragma config CP = OFF         // PFM and Data EEPROM Code Protection bit (PFM and Data EEPROM code protection disabled)

// #pragma config statements should precede project file includes.
// Use project enums instead of #define for ON and OFF.

#include <xc.h>
#include <stdio.h>

//#define Z80_CLK 2500000UL // Z80 clock frequency(Max 16MHz)

//#define ROM_SIZE 0x4000 // ROM size 16K bytes
//#define RAM_SIZE 0x1000 // RAM size 4K bytes
//#define RAM_TOP 0x8000 // RAM start address

// CDP1802
//#define Z80_CLK 1800000UL // CDP1802 clock frequency(1.8MHz)
#define Z80_CLK   200000UL // CDP1802 clock frequency(0.2MHz)

// for Low address test ($0000-$00FF)
//#define ROM_SIZE 0x80 // ROM size 128 bytes
//#define RAM_SIZE 0x80 // RAM size 128 bytes
//#define RAM_TOP 0x80 // RAM start address

// for High Address (ROM $0000-$0400, RAM $8000-8FFF)
//#define ROM_SIZE 0x0030 // ROM size 256 bytes
#define ROM_SIZE 0x0400 // ROM size 1k bytes
#define RAM_SIZE 0x1000 // RAM size 4k bytes
#define RAM_TOP 0x8000 // RAM start address

#define UART_DREG 0xE000 // UART data register address
#define UART_CREG 0xE001 // UART control register address

#define _XTAL_FREQ 64000000UL

extern const unsigned char rom[]; // Equivalent to ROM, see end of this file
unsigned char ram[RAM_SIZE]; // Equivalent to RAM
static union {
    unsigned int w; // 16 bits Address
    struct {
        unsigned char l; // Address low 8 bits
        unsigned char h; // Address high 8 bits
    };
} address;
    

/*
// UART3 Transmit
void putch(char c) {
    while(!U3TXIF); // Wait or Tx interrupt flag set
    U3TXB = c; // Write data
}

// UART3 Recive
char getch(void) {
    while(!U3RXIF); // Wait for Rx interrupt flag set
    return U3RXB; // Read data
}
*/

//#define dff_reset() {G3POL = 1; G3POL = 0;}
#define db_setin() (TRISC = 0xff)
#define db_setout() (TRISC = 0x00)

// Never called, logically
void __interrupt(irq(default),base(8)) Default_ISR(){}

#ifdef USED_IOC
/**
   IOCAF1 Interrupt Service Routine TPB(RA1) Rising edge
 */
// Called at COSMAC TPB(RA2) Rising edge for EMU1802mini
void IOCAF2_ISR(void) {
    IOCAFbits.IOCAF2 = 0;
    //address.h = 0; // Read address high (256byte only)
    address.l = PORTB; // Read address low
    
    if(!RA5) { // COSMAC memory read cycle (MRD active)
        db_setout(); // Set data bus as output
        if(address.w < ROM_SIZE){ // ROM area
            LATC = rom[address.w]; // Out ROM data
        } else if((address.w >= RAM_TOP) && (address.w < (RAM_TOP + RAM_SIZE))){ // RAM area
            LATC = ram[address.w - RAM_TOP]; // RAM data
        //} else if(address.w == UART_CREG){ // UART control register
        //    LATC = PIR9; // U3 flag
        //} else if(address.w == UART_DREG){ // UART data register
        //    LATC = U3RXB; // U3 RX buffer
        } else { // Out of memory
            LATC = 0xff; // Invalid data
        }
    } else { // COSMAC memory write cycle (MWR active)
        //if(RE0) while(RE0);
        //if(!RE0) {
        if(!RA0) {  // EMU1802mini RA0 (MWR)
            if((address.w >= RAM_TOP) && (address.w < (RAM_TOP + RAM_SIZE))){ // RAM area
                ram[address.w - RAM_TOP] = PORTC; // Write into RAM
            //} else if(address.w == UART_DREG) { // UART data register
            //    U3TXB = PORTC; // Write into U3 TX buffer
            }
        }
    }
}

/**
   IOCAF2 Interrupt Service Routine
*/
// Called at COSMAC TPA(RA3) Falling edge for EMU1802mini
void IOCAF3_ISR(void) {
    IOCAFbits.IOCAF3 = 0;
    address.h = PORTB;  // Read address high
}

void __interrupt(irq(IOC),base(8)) PIN_MANAGER_IOC()
{   
	// interrupt on change for pin IOCAF2
    if(IOCAFbits.IOCAF2 == 1)
    {
        IOCAF2_ISR();  
    }	
	// interrupt on change for pin IOCAF3
    if(IOCAFbits.IOCAF3 == 1)
    {
        IOCAF3_ISR();  
    }	
}
#endif

//  Called at COSMAC TPA(RA3) Riging edge for EMU1802mini
void __interrupt(irq(INT0),base(8)) INT0_ISR(){
    INT0IF = 0; // Clear interrupt flag
    db_setin(); // Set data bus as input
    address.h = PORTB;  // Read address high
    //printf("SET HIGH ADRS:%04X.\r\n",address.w);
}

//  Called at COSMAC TPB(RA2) Riging edge for EMU1802mini
void __interrupt(irq(INT1),base(8)) INT1_ISR(){
    address.l = PORTB; // Read address low  
    if(!RA5) { // COSMAC memory read cycle (MRD active)
        db_setout(); // Set data bus as output
        if(address.w < ROM_SIZE){ // ROM area
            LATC = rom[address.w]; // Out ROM data
            //printf("RD ADRS:%04X DATA:%02X\r\n",address.w,rom[address.w]);  
        } else if((address.w >= RAM_TOP) && (address.w < (RAM_TOP + RAM_SIZE))){ // RAM area
            LATC = ram[address.w - RAM_TOP]; // RAM data
            //printf("RD ADRS:%04X DATA:%02X\r\n",address.w,ram[address.w - RAM_TOP]);  
        } else if(address.w == UART_CREG){ // UART control register
            LATC = PIR9; // U3 flag
        } else if(address.w == UART_DREG){ // UART data register
            LATC = U3RXB; // U3 RX buffer
        } else { // Out of memory
            LATC = 0xff; // Invalid data
        }
    }
    INT1IF = 0; // Clear interrupt flag
}

//  Called at COSMAC MWR(RA0) Falling edge for EMU1802mini
void __interrupt(irq(INT2),base(8)) INT2_ISR(){
    address.l = PORTB; // Read address low
    // COSMAC memory write cycle (MWR active)
    if((address.w >= RAM_TOP) && (address.w < (RAM_TOP + RAM_SIZE))){ // RAM area
        ram[address.w - RAM_TOP] = PORTC; // Write into RAM
        //printf("WRITE RAM ADRS:%04X DATA:%02X\r\n",address.w,ram[address.w - RAM_TOP]);  
    } else if(address.w == UART_DREG) { // UART data register
        U3TXB = PORTC; // Write into U3 TX buffer
    }
    INT2IF = 0; // Clear interrupt flag
}

// main routine
void main(void) {
    // System initialize
    OSCFRQ = 0x08; // 64MHz internal OSC

    // Address bus A7-A0 pin (RB0-RB7)
    ANSELB = 0x00; // Disable analog function
    WPUB = 0xff; // Week pull up
    TRISB = 0xff; // Set as input

    // Data bus D7-D0 pin (RC0-RC7)
    ANSELC = 0x00; // Disable analog function
    WPUC = 0xff; // Week pull up
    TRISC = 0xff; // Set as input(default)

    // MWR input pin (RE0)
    // MWR input pin (RA0) for EMU1802mini
    ANSELA0 = 0; // Disable analog function
    WPUA0 = 1; // Week pull up
    TRISA0 = 1; // Set as input

    // RESET output pin (RE1)
    // RESET output pin (RA1) for EMU1802mini
    ANSELA1 = 0; // Disable analog function
    LATA1 = 0; // Reset
    TRISA1 = 0; // Set as output

    // MRD input pin (RA5)
    ANSELA5 = 0; // Disable analog function
    WPUA5 = 1; // Week pull up
    TRISA5 = 1; // Set as intput

    // clock(RA4) by NCO FDC mode for EMU1802mini
    RA4PPS = 0x3f; // RA4 asign NCO1
    ANSELA4 = 0; // Disable analog function
    TRISA4 = 0; // PWM output pin
    NCO1INCU = (unsigned char)((Z80_CLK*2/61/65536) & 0xff);
    NCO1INCH = (unsigned char)((Z80_CLK*2/61/256) & 0xff);
    NCO1INCL = (unsigned char)((Z80_CLK*2/61) & 0xff);
    NCO1CLK = 0x00; // Clock source Fosc
    NCO1PFM = 0;  // FDC mode
    NCO1OUT = 1;  // NCO output enable
    NCO1EN = 1;   // NCO enable

    // UART3 initialize
    U3BRG = 416; // 9600bps @ 64MHz
    U3RXEN = 1; // Receiver enable
    U3TXEN = 1; // Transmitter enable

    // UART3 Receiver
    ANSELA7 = 0; // Disable analog function
    TRISA7 = 1; // RX set as input
    U3RXPPS = 0x07; //RA7->UART3:RX3;

    // UART3 Transmitter
    ANSELA6 = 0; // Disable analog function
    LATA6 = 1; // Default level
    TRISA6 = 0; // TX set as output
    RA6PPS = 0x26;  //RA6->UART3:TX3;

    U3ON = 1; // Serial port enable
    
    // TPB(RA2) input pin for EMU1802mini
    ANSELA2 = 0; // Disable analog function
    WPUA2 = 1; // Week pull up
    TRISA2 = 1; // Set as input

    // TPA(RA3) input pin for EMU1802mini
    ANSELA3 = 0; // Disable analog function
    WPUA3 = 1; // Week pull up
    TRISA3 = 1; // Set as input
  
    // INTERRUPT_Initialize
    //
    // Vectored Interrupt Controller setting sequence
    INTCON0bits.IPEN = 1; // Interrupt priority enable

    IVTLOCK = 0x55;
    IVTLOCK = 0xAA;
    IVTLOCKbits.IVTLOCKED = 0x00; // Unlock IVT

    IVTBASEU = 0;
    IVTBASEH = 0;
    IVTBASEL = 8; // Default VIT base address

    IVTLOCK = 0x55;
    IVTLOCK = 0xAA;
    IVTLOCKbits.IVTLOCKED = 0x01; // Lock IVT

#ifdef USED_IOC
    // Assign peripheral interrupt priority vectors
    IPR0bits.IOCIP = 1;

    /**
    IOCx registers 
    */
    //interrupt on change for group IOCAF - flag COSMAC TPB(RA1)
    //interrupt on change for group IOCAF - flag COSMAC TPB(RA2) for mini
    IOCAFbits.IOCAF2 = 0;
    //interrupt on change for group IOCAF - flag COSMAC TPA(RA2)
    //interrupt on change for group IOCAF - flag COSMAC TPA(RA3) for mini
    IOCAFbits.IOCAF3 = 0;
    //interrupt on change for group IOCAN - negative
    IOCANbits.IOCAN2 = 0;
    //interrupt on change for group IOCAN - negative COSMAC TPA(RA2) Falling edge
    //interrupt on change for group IOCAN - negative COSMAC TPA(RA3) Falling edge for mini
    IOCANbits.IOCAN3 = 1;
    //interrupt on change for group IOCAP - positive COSMAC TPB(RA1) Rising edge
    //interrupt on change for group IOCAP - positive COSMAC TPB(RA2) Rising edge for mini
    IOCAPbits.IOCAP2 = 1;
    //interrupt on change for group IOCAP - positive
    IOCAPbits.IOCAP3 = 0;
 
    // Enable IOCI interrupt 
    PIE0bits.IOCIE = 1; 
#endif

    // INT0 VI enable
    // COSMAC TPA(RA3) Riging edge
    INT0PPS = 0x3; //RA3->INTERRUPT MANAGER:INT0; for EMU1802mini
    INT0EDG = 1; // 0: Falling edge 1: Rising edge
    INT0IE = 1;
   
    // INT1 VI enable
    // COSMAC TPB(RA2) Riging edge
    INT1PPS = 0x2; //RA2->INTERRUPT MANAGER:INT1; for EMU1802mini
    INT1EDG = 1; // 0: Falling edge 1: Rising edge
    INT1IE = 1;

    // INT2 VI enable
    // COSMAC MWR(RA0) Falling edge
    INT2PPS = 0x0; //RA0->INTERRUPT MANAGER:INT2; for EMU1802mini
    INT2EDG = 0; // 0: Falling edge 1: Rising edge
    INT2IE = 1;

    // COSMAC start
    GIE = 1; // Global interrupt enable
    LATA1 = 1; // Release reset COSMAC ~CLEAR(RA1) for mini
    
    while(1); // All things come to those who wait
}

// blink program 1
//00  7B               1->Q
//01  7A               0->Q
//02  30 00            00->R(P).0

// Counter program 2 (Low RAM $0081 R/W)
//0000 F8 81             8 (   2) START   LDI     #IOR    ;D <- $81  $0081
//0002 A3                9 (   2)         PLO     3       ;R(3).0 <- D
//0003 E3               10 (   2)         SEX     3       ;X <- 3
//0004 84               11 (   2) LOOP1   GLO     4       ;D <- R(4).0
//0005 53               12 (   2)         STR     3       ;M(R(3)) <- D
//0006 61               13 (   2)         OUT     1       ;BUS <- M(R(3)); R(3)++
//0007 23               14 (   2)         DEC     3       ;R(3)--
//0008 14               15 (   2)         INC     4       ;R(4)++
//0009 30 04            16 (   2)         BR      LOOP1   ;Branch to LOOP1

// Counter program 3  (High RAM $8008 R/W)
//0000 F8 80             8 (   2) START   LDI     /RAM    ;D <- $80  $8007
//0002 B3                9 (   2)         PHI     3       ;R(3).1 <- D
//0003 F8 08            10 (   2)         LDI     #RAM    ;D <- $07
//0005 A3               11 (   2)         PLO     3       ;R(3).0 <- D
//0006 E3               13 (   2)         SEX     3       ;X <- 3
//0007 84               14 (   2) LOOP1   GLO     4       ;D <- R(4).0
//0008 53               15 (   2)         STR     3       ;M(R(3)) <- D
//0009 61               16 (   2)         OUT     1       ;BUS <- M(R(3)); R(3)++
//000A 23               17 (   2)         DEC     3       ;R(3)--
//000B 14               18 (   2)         INC     4       ;R(4)++
//000C 30 07            19 (   2)         BR      LOOP1   ;Branch to LOOP1

// memory move program 4
// $0000-$0030 -> $8008-$8038 + OUT 1
//0000-                  7        SOURCE  .EQ     $0000
//0070-                  9        MAXADD  .EQ     $0030
//0080-                  8        DESTIN  .EQ     $8008
//00F0-                 10        MAXDUMP .EQ     $8039
//0000-                 13        PROGPC  .EQ     0
//
//0000-F8 00            33 (   2) START:  LDI     /BEG
//0002-B9               34 (   2)         PHI     R9
//0003-F8 07            35 (   2)         LDI     #BEG
//0005-A9               36 (   2)         PLO     R9
//0006-D9               37 (   2)         SEP     R9
//0007-                 38
//0007-F8 00            39 (   2) BEG:    LDI     /SOURCE
//0009-BA               40 (   2)         PHI     RA
//000A-F8 00            41 (   2)         LDI     #SOURCE
//000C-AA               42 (   2)         PLO     RA
//000D-                 43
//000D-F8 80            44 (   2)         LDI     /DESTIN
//000F-BB               45 (   2)         PHI     RB
//0010-F8 08            46 (   2)         LDI     #DESTIN
//0012-AB               47 (   2)         PLO     RB
//0013-                 48
//0013-4A               49 (   2) REPEAT: LDA     RA
//0014-5B               50 (   2)         STR     RB
//0015-1B               51 (   2)         INC     RB
//0016-8A               52 (   2)         GLO     RA
//0017-FB 31            53 (   2)         XRI     #MAXADD+1
//0019-3A 13            54 (   2)         BNZ     REPEAT
//001B-                 55
//001B-F8 80            56 (   2) DUMP:   LDI     /DESTIN
//001D-BB               57 (   2)         PHI     RB
//001E-F8 08            58 (   2)         LDI     #DESTIN
//0020-AB               59 (   2)         PLO     RB
//0021-EB               60 (   2)         SEX     RB
//0022-61               61 (   2) REPEAT2: OUT    1
//0023-8B               62 (   2)         GLO     RB
//0024-FB 39            63 (   2)         XRI     #MAXDUMP+1
//0026-3A 22            64 (   2)         BNZ     REPEAT2
//0028-                 65
//0028-                 66
//0028-30 28            67 (   2) ENDLOOP: BR ENDLOOP

const unsigned char rom[ROM_SIZE] = {
#ifdef false
    // Program 1: Blink
    0x7b, 0x7a, 0x30, 0x00, 0xff, 0xff, 0xff, 0xff, // 0000

    // Program 2: Counter2 (Low RAM $0081 R/W)
    0xf8, 0x81, 0xa3, 0xe3, 0x84, 0x53, 0x61, 0x23, // 0000
    0x14, 0x30, 0x04, 0xff, 0xff, 0xff, 0xff, 0xff,
    0xff, 0xff, 0xff, 0xff, 0xff, 0xff, 0xff, 0xff, // 0010
    0xff, 0xff, 0xff, 0xff, 0xff, 0xff, 0xff, 0xff
            
    // Program 3: Counter3 (High RAM $8008 R/W)
    0xf8, 0x80, 0xb3, 0xf8, 0x08, 0xa3, 0xe3, 0x84, // 0000
    0x53, 0x61, 0x23, 0x14, 0x30, 0x07, 0xff, 0xff,
    0xff, 0xff, 0xff, 0xff, 0xff, 0xff, 0xff, 0xff, // 0010
    0xff, 0xff, 0xff, 0xff, 0xff, 0xff, 0xff, 0xff,
    0xff, 0xff, 0xff, 0xff, 0xff, 0xff, 0xff, 0xff, // 0020
    0xff, 0xff, 0xff, 0xff, 0xff, 0xff, 0xff, 0xff
            
    // Program 4: memory move and dump $0000 -> $8008 $30byte
    0xF8, 0x00, 0xB9, 0xF8, 0x07, 0xA9, 0xD9, 0xF8, // 0000
    0x00, 0xBA, 0xF8, 0x00, 0xAA, 0xF8, 0x80, 0xBB,
    0xF8, 0x08, 0xAB, 0x4A, 0x5B, 0x1B, 0x8A, 0xFB, // 0010
    0x31, 0x3A, 0x13, 0xF8, 0x80, 0xBB, 0xF8, 0x08,
    0xAB, 0xEB, 0x61, 0x8B, 0xFB, 0x39, 0x3A, 0x22, // 0020
    0x30, 0x28, 0xff, 0xff, 0xff, 0xff, 0xff, 0xff

    // Program 5: Save register (Save area $8000-$801F)
    0xF8, 0x00, 0xB0, 0xF8, 0x80, 0xB1, 0xF8, 0x1E, // 0000
    0xA1, 0xF8, 0xA0, 0xB4, 0xE1, 0xF8, 0xD0, 0x51,
    0xF3, 0x3A, 0x28, 0x21, 0x94, 0xFC, 0x70, 0x33, // 0010
    0x1B, 0xFC, 0x21, 0xFC, 0x7F, 0xB4, 0x51, 0xF3,
    0x3A, 0x28, 0xD1, 0x51, 0x21, 0x21, 0x30, 0x0D, // 0020
    0x30, 0x28, 0xff, 0xff, 0xff, 0xff, 0xff, 0xff
           
// Program 6: IDIOT (0000-03FF) Using Software serial of COSMAC
// ORG:0000 EFHI:0 QHI:0
0x71,0x00,0xF8,0xFF,0xB4,0xF8,0xFF,0xA4,0x54,0x04,0xFB,0xFF,0xC6,0x54,0x04,0x32,
0x1A,0x94,0x32,0xDD,0xA4,0x24,0x84,0xB4,0x30,0x05,0xF8,0xDF,0xA4,0xE4,0x8F,0x73,
0x9F,0x73,0x8E,0x73,0x9E,0x73,0x8D,0x73,0x9D,0x73,0x8C,0x73,0x9C,0x73,0x8B,0x73,
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0x95,0xFF,0x01,0xB5,0x95,0xFF,0x01,0xB5,0x00,0x00,0x00,0x00,0x00,0x00,0x30,0x7C            

// Program 7: HELLO WORLD and ECHO BACK Using UART of PIC18F27Q43 ($0000-$003F)
0xF8,0x00,0xB1,0xF8,0x2C,0xA1,0xE1,0xF8,0xE0,0xB2,0xB3,0xF8,0x00,0xA2,0xF8,0x01,
0xA3,0x03,0xFA,0x02,0x32,0x11,0x72,0x32,0x1C,0x52,0x30,0x11,0x03,0xFA,0x01,0x32,
0x1C,0x02,0xA4,0x03,0xFA,0x02,0x32,0x23,0x84,0x52,0x30,0x1C,0x48,0x45,0x4C,0x4C,
0x4F,0x20,0x57,0x4F,0x52,0x4C,0x44,0x0D,0x0A,0x00,0xFF,0xFF,0xFF,0xFF,0xFF,0xFF
#endif

// Program 8: IDIOT Using UART of PIC18F27Q43 (0000-03FF)
0x71,0x00,0xF8,0xFF,0xB4,0xF8,0xFF,0xA4,0x54,0x04,0xFB,0xFF,0xC6,0x54,0x04,0x32,
0x1A,0x94,0x32,0xE3,0xA4,0x24,0x84,0xB4,0x30,0x05,0xF8,0xDF,0xA4,0xE4,0x8F,0x73,
0x9F,0x73,0x8E,0x73,0x9E,0x73,0x8D,0x73,0x9D,0x73,0x8C,0x73,0x9C,0x73,0x8B,0x73,
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0x95,0xFF,0x01,0xB5,0x95,0xFF,0x01,0xB5,0x00,0x00,0x00,0x00,0x00,0x00,0x30,0x7C

};
